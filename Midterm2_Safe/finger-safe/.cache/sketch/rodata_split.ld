/* Auto-generated linker script fragment for LLEXT
 * Separates .rodata sections based on relocation status
 */

SECTIONS
{
    /* Read-only data WITH relocations - will be copied to RAM by LLEXT */
    .rodata : {
        *(.rodata._ZN6zephyr7arduinoL11pinctrl_mapE)
        *(.rodata._ZN6zephyr7arduinoL12arduino_pinsE)
        *(.rodata._ZN6zephyr7arduinoL35__pinctrl_states__device_dts_ord_17E)
        *(.rodata._ZN6zephyr7arduinoL35__pinctrl_states__device_dts_ord_30E)
        *(.rodata._ZN6zephyr7arduinoL35__pinctrl_states__device_dts_ord_34E)
        *(.rodata._ZN6zephyr7arduinoL35__pinctrl_states__device_dts_ord_40E)
        *(.rodata._ZN6zephyr7arduinoL35__pinctrl_states__device_dts_ord_61E)
        *(.rodata._ZN6zephyr7arduinoL35__pinctrl_states__device_dts_ord_70E)
        *(.rodata._ZN6zephyr7arduinoL35__pinctrl_states__device_dts_ord_73E)
        *(.rodata._ZN6zephyr7arduinoL35__pinctrl_states__device_dts_ord_78E)
        *(.rodata._ZN6zephyr7arduinoL35__pinctrl_states__device_dts_ord_83E)
        *(.rodata._ZN6zephyr7arduinoL35__pinctrl_states__device_dts_ord_88E)
        *(.rodata._ZN6zephyr7arduinoL36__pinctrl_states__device_dts_ord_100E)
        *(.rodata._ZN6zephyr7arduinoL36__pinctrl_states__device_dts_ord_105E)
        *(.rodata._ZN6zephyr7arduinoL36__pinctrl_states__device_dts_ord_109E)
        *(.rodata._ZN6zephyr7arduinoL36__pinctrl_states__device_dts_ord_114E)
        *(.rodata._ZN6zephyr7arduinoL36__pinctrl_states__device_dts_ord_120E)
        *(.rodata._ZN6zephyr7arduinoL36__pinctrl_states__device_dts_ord_123E)
        *(.rodata._ZN6zephyr7arduinoL39__pinctrl_dev_config__device_dts_ord_17E)
        *(.rodata._ZN6zephyr7arduinoL39__pinctrl_dev_config__device_dts_ord_30E)
        *(.rodata._ZN6zephyr7arduinoL39__pinctrl_dev_config__device_dts_ord_34E)
        *(.rodata._ZN6zephyr7arduinoL39__pinctrl_dev_config__device_dts_ord_40E)
        *(.rodata._ZN6zephyr7arduinoL39__pinctrl_dev_config__device_dts_ord_61E)
        *(.rodata._ZN6zephyr7arduinoL39__pinctrl_dev_config__device_dts_ord_70E)
        *(.rodata._ZN6zephyr7arduinoL39__pinctrl_dev_config__device_dts_ord_73E)
        *(.rodata._ZN6zephyr7arduinoL39__pinctrl_dev_config__device_dts_ord_78E)
        *(.rodata._ZN6zephyr7arduinoL39__pinctrl_dev_config__device_dts_ord_83E)
        *(.rodata._ZN6zephyr7arduinoL39__pinctrl_dev_config__device_dts_ord_88E)
        *(.rodata._ZN6zephyr7arduinoL40__pinctrl_dev_config__device_dts_ord_100E)
        *(.rodata._ZN6zephyr7arduinoL40__pinctrl_dev_config__device_dts_ord_105E)
        *(.rodata._ZN6zephyr7arduinoL40__pinctrl_dev_config__device_dts_ord_109E)
        *(.rodata._ZN6zephyr7arduinoL40__pinctrl_dev_config__device_dts_ord_114E)
        *(.rodata._ZN6zephyr7arduinoL40__pinctrl_dev_config__device_dts_ord_120E)
        *(.rodata._ZN6zephyr7arduinoL40__pinctrl_dev_config__device_dts_ord_123E)
        *(.rodata._ZTIN10__cxxabiv117__class_type_infoE)
        *(.rodata._ZTIN10__cxxabiv120__si_class_type_infoE)
        *(.rodata._ZTIN12_GLOBAL__N_121system_error_categoryE)
        *(.rodata._ZTIN12_GLOBAL__N_122generic_error_categoryE)
        *(.rodata._ZTINSt3_V214error_categoryE)
        *(.rodata._ZTISt11logic_error)
        *(.rodata._ZTISt12length_error)
        *(.rodata._ZTISt17bad_function_call)
        *(.rodata._ZTISt9bad_alloc)
        *(.rodata._ZTISt9exception)
        *(.rodata._ZTISt9type_info)
        *(.rodata._ZTV13BridgeMonitorILj512EE)
        *(.rodata._ZTV15SerialTransport)
        *(.rodata._ZTV18RpcFunctionWrapperISt8functionIFviiiiEEE)
        *(.rodata._ZTVN10__cxxabiv117__class_type_infoE)
        *(.rodata._ZTVN10__cxxabiv120__si_class_type_infoE)
        *(.rodata._ZTVN12_GLOBAL__N_121system_error_categoryE)
        *(.rodata._ZTVN12_GLOBAL__N_122generic_error_categoryE)
        *(.rodata._ZTVN7arduino12ZephyrSerialE)
        *(.rodata._ZTVN7arduino9IPAddressE)
        *(.rodata._ZTVSt11logic_error)
        *(.rodata._ZTVSt12length_error)
        *(.rodata._ZTVSt17bad_function_call)
        *(.rodata._ZTVSt9bad_alloc)
    }

    /* Read-only data WITHOUT relocations - kept in flash by LLEXT */
    .llext.rodata.noreloc : {
        *(.rodata)
        *(.rodata._Z13buttonServicem.str1.1)
        *(.rodata._Z15sequenceServicem.str1.1)
        *(.rodata._ZL10SERVO_PINS)
        *(.rodata._ZL10UNLOCK_SEQ)
        *(.rodata._ZN10RpcDecoderILj1024EE12get_responseIN7arduino7msgpack6object5nil_tEEEbjRT_R8RpcError.str1.1)
        *(.rodata._ZN10RpcDecoderILj1024EE12get_responseIbEEbjRT_R8RpcError.str1.1)
        *(.rodata._ZN11BridgeClass11update_safeEv.str1.1)
        *(.rodata._ZN11BridgeClass5beginEm.str1.1)
        *(.rodata._ZN13BridgeMonitorILj512EE5_readEj.str1.1)
        *(.rodata._ZN13BridgeMonitorILj512EE5writeEPKhj.str1.1)
        *(.rodata._ZN13BridgeMonitorILj512EEcvbEv.str1.1)
        *(.rodata._ZN18RpcFunctionWrapperISt8functionIFviiiiEEEclERN7arduino7msgpack8UnpackerERNS5_6PackerE.str1.1)
        *(.rodata._ZN6zephyr7arduinoL41__pinctrl_state_pins_0__device_dts_ord_17E)
        *(.rodata._ZN6zephyr7arduinoL41__pinctrl_state_pins_0__device_dts_ord_30E)
        *(.rodata._ZN6zephyr7arduinoL41__pinctrl_state_pins_0__device_dts_ord_34E)
        *(.rodata._ZN6zephyr7arduinoL41__pinctrl_state_pins_0__device_dts_ord_40E)
        *(.rodata._ZN6zephyr7arduinoL41__pinctrl_state_pins_0__device_dts_ord_61E)
        *(.rodata._ZN6zephyr7arduinoL41__pinctrl_state_pins_0__device_dts_ord_70E)
        *(.rodata._ZN6zephyr7arduinoL41__pinctrl_state_pins_0__device_dts_ord_73E)
        *(.rodata._ZN6zephyr7arduinoL41__pinctrl_state_pins_0__device_dts_ord_78E)
        *(.rodata._ZN6zephyr7arduinoL41__pinctrl_state_pins_0__device_dts_ord_83E)
        *(.rodata._ZN6zephyr7arduinoL41__pinctrl_state_pins_0__device_dts_ord_88E)
        *(.rodata._ZN6zephyr7arduinoL41__pinctrl_state_pins_1__device_dts_ord_17E)
        *(.rodata._ZN6zephyr7arduinoL41__pinctrl_state_pins_1__device_dts_ord_40E)
        *(.rodata._ZN6zephyr7arduinoL41__pinctrl_state_pins_2__device_dts_ord_17E)
        *(.rodata._ZN6zephyr7arduinoL42__pinctrl_state_pins_0__device_dts_ord_100E)
        *(.rodata._ZN6zephyr7arduinoL42__pinctrl_state_pins_0__device_dts_ord_105E)
        *(.rodata._ZN6zephyr7arduinoL42__pinctrl_state_pins_0__device_dts_ord_109E)
        *(.rodata._ZN6zephyr7arduinoL42__pinctrl_state_pins_0__device_dts_ord_114E)
        *(.rodata._ZN6zephyr7arduinoL42__pinctrl_state_pins_0__device_dts_ord_120E)
        *(.rodata._ZN6zephyr7arduinoL42__pinctrl_state_pins_0__device_dts_ord_123E)
        *(.rodata._ZN6zephyr7arduinoL42__pinctrl_state_pins_1__device_dts_ord_100E)
        *(.rodata._ZN6zephyr7arduinoL42__pinctrl_state_pins_1__device_dts_ord_105E)
        *(.rodata._ZN6zephyr7arduinoL42__pinctrl_state_pins_1__device_dts_ord_109E)
        *(.rodata._ZN6zephyr7arduinoL42__pinctrl_state_pins_1__device_dts_ord_114E)
        *(.rodata._ZN6zephyr7arduinoL42__pinctrl_state_pins_1__device_dts_ord_120E)
        *(.rodata._ZN6zephyr7arduinoL42__pinctrl_state_pins_1__device_dts_ord_123E)
        *(.rodata._ZN6zephyr7arduinoL42__pinctrl_state_pins_2__device_dts_ord_100E)
        *(.rodata._ZN6zephyr7arduinoL42__pinctrl_state_pins_2__device_dts_ord_105E)
        *(.rodata._ZN6zephyr7arduinoL42__pinctrl_state_pins_2__device_dts_ord_109E)
        *(.rodata._ZN6zephyr7arduinoL42__pinctrl_state_pins_2__device_dts_ord_114E)
        *(.rodata._ZN6zephyr7arduinoL42__pinctrl_state_pins_2__device_dts_ord_120E)
        *(.rodata._ZN6zephyr7arduinoL42__pinctrl_state_pins_2__device_dts_ord_123E)
        *(.rodata._ZN7RpcCallIJEE6resultIbEEbRT_.part.0.str1.1)
        *(.rodata._ZN7RpcCallIJEEC2ERKN7arduino6StringEP9RPCClientP7k_mutexS8_.str1.1)
        *(.rodata._ZN7arduino5Print7printlnEv.str1.1)
        *(.rodata._ZN7arduino7msgpack6object3extC2EaPKhj.str1.1)
        *(.rodata._ZN8RpcErrorC2Ev.str1.1)
        *(.rodata._ZNK12_GLOBAL__N_121system_error_category4nameEv.str1.1)
        *(.rodata._ZNK12_GLOBAL__N_122generic_error_category4nameEv.str1.1)
        *(.rodata._ZNK12_GLOBAL__N_122generic_error_category7messageB5cxx11Ei.str1.1)
        *(.rodata._ZNKSt17bad_function_call4whatEv.str1.1)
        *(.rodata._ZNKSt9bad_alloc4whatEv.str1.1)
        *(.rodata._ZNSs12_S_constructIPKcEEPcT_S3_RKSaIcESt20forward_iterator_tag.isra.0.str1.1)
        *(.rodata._ZNSs4_Rep9_S_createEjjRKSaIcE.str1.1)
        *(.rodata._ZNSt6vectorIjSaIjEE17_M_realloc_appendIJRjEEEvDpOT_.str1.1)
        *(.rodata._ZNSt7__cxx1112basic_stringIcSt11char_traitsIcESaIcEE9_M_createERjj.str1.1)
        *(.rodata._ZTSN10__cxxabiv117__class_type_infoE)
        *(.rodata._ZTSN10__cxxabiv120__si_class_type_infoE)
        *(.rodata._ZTSN12_GLOBAL__N_121system_error_categoryE)
        *(.rodata._ZTSN12_GLOBAL__N_122generic_error_categoryE)
        *(.rodata._ZTSNSt3_V214error_categoryE)
        *(.rodata._ZTSSt11logic_error)
        *(.rodata._ZTSSt12length_error)
        *(.rodata._ZTSSt17bad_function_call)
        *(.rodata._ZTSSt9bad_alloc)
        *(.rodata._ZTSSt9exception)
        *(.rodata._ZTSSt9type_info)
        *(.rodata.loop.str1.1)
        *(.rodata.setup.str1.1)
        *(.rodata.str1.1)
    }

    /* Merge all .rel.rodata.* sections into .rel.rodata */
    .rel.rodata : {
        *(.rel.rodata)
        *(.rel.rodata.*)
    }

    /* Merge all .rela.rodata.* sections into .rela.rodata */
    .rela.rodata : {
        *(.rela.rodata)
        *(.rela.rodata.*)
    }

}
